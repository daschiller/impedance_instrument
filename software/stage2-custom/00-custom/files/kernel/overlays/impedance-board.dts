/*
 * Wood K-Plus overlay
 */

/dts-v1/;
/plugin/;

/ {
	compatible = "brcm,bcm2835";

	fragment@0 {
		target = <&i2c_arm>;
		__overlay__ {
			#address-cells = <1>;
			#size-cells = <0>;
			status = "okay";

			ad5933: ad5933@d {
				compatible = "adi,ad5933";
				status = "okay";
				reg = <0x0d>;
				vdd-supply = <&vdd_3v3_reg>;
			};
		};
	};
};
